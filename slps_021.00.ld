SECTIONS
{
    __romPos = 0;
    _gp = 0x8008B190;
    header_ROM_START = __romPos;
    header_VRAM = ADDR(.header);
    .header : AT(header_ROM_START) SUBALIGN(2)
    {
        FILL(0x00000000);
        header_DATA_START = .;
        header = .;
        build/asm/header.o(.data);
        header_DATA_END = .;
        header_DATA_SIZE = ABSOLUTE(header_DATA_END - header_DATA_START);
    }
    __romPos += SIZEOF(.header);
    header_ROM_END = __romPos;
    header_VRAM_END = .;

    main_ROM_START = __romPos;
    main_VRAM = ADDR(.main);
    .main 0x80010000 : AT(main_ROM_START) SUBALIGN(4)
    {
        FILL(0x00000000);
        main_RODATA_START = .;
        build/asm/data/800.rodata.o(.rodata);
        build/asm/28DC.o(.rodata);
        build/src/mainLoop.o(.rodata);
        build/src/initGame.o(.rodata);
        build/src/boot.o(.rodata);
        build/asm/12D24.o(.rodata);
        build/asm/psxsdk/libspu/spu.o(.rodata);
        build/asm/psxsdk/libspu/s_ini.o(.rodata);
        build/asm/psxsdk/libspu/s_dcb.o(.rodata);
        build/asm/psxsdk/libsn/snmain.o(.rodata);
        build/asm/psxsdk/libcd/bios.o(.rodata);
        build/asm/psxsdk/libgs/gsInitGraph.o(.rodata);
        build/asm/psxsdk/libgs/gsSetDrawBuffOffset.o(.rodata);
        build/asm/psxsdk/libgs/gsSetDrawBuffClip.o(.rodata);
        build/asm/psxsdk/libgs/gsInit3D.o(.rodata);
        build/asm/psxsdk/libgpu/p09.o(.rodata);
        build/asm/psxsdk/libgpu/p10.o(.rodata);
        build/asm/data/47EE0.rodata.o(.rodata);
        build/asm/47EF8.o(.rodata);
        build/asm/data/psxsdk/libcard/patch_card.rodata.o(.rodata);
        build/asm/data/pxsdk/libcard/patch_card2.rodata.o(.rodata);
        build/asm/psxsdk/libcard/patch_card2.o(.rodata);
        build/asm/psxsdk/libapi/a36.o(.rodata);
        build/asm/psxsdk/libapi/a37.o(.rodata);
        build/asm/psxsdk/libapi/open.o(.rodata);
        build/asm/psxsdk/libapi/lseek.o(.rodata);
        build/asm/psxsdk/libapi/read.o(.rodata);
        build/asm/psxsdk/libapi/write.o(.rodata);
        build/asm/psxsdk/libapi/close.o(.rodata);
        build/asm/psxsdk/libapi/nextFile.o(.rodata);
        build/asm/psxsdk/libapi/erase.o(.rodata);
        build/asm/psxsdk/libapi/changeClearPad.o(.rodata);
        build/asm/49EAC.o(.rodata);
        . = ALIGN(., 4);
        main_RODATA_END = .;
        main_RODATA_SIZE = ABSOLUTE(main_RODATA_END - main_RODATA_START);
        main_TEXT_START = .;
        build/asm/28DC.o(.text);
        build/src/mainLoop.o(.text);
        build/src/initGame.o(.text);
        build/src/boot.o(.text);
        build/asm/12D24.o(.text);
        build/asm/psxsdk/libspu/spu.o(.text);
        build/asm/psxsdk/libspu/s_ini.o(.text);
        build/asm/psxsdk/libspu/s_dcb.o(.text);
        build/asm/psxsdk/libsn/snmain.o(.text);
        build/asm/psxsdk/libcd/bios.o(.text);
        build/asm/psxsdk/libgs/gsInitGraph.o(.text);
        build/asm/psxsdk/libgs/gsSetDrawBuffOffset.o(.text);
        build/asm/psxsdk/libgs/gsSetDrawBuffClip.o(.text);
        build/asm/psxsdk/libgs/gsInit3D.o(.text);
        build/asm/psxsdk/libgpu/p09.o(.text);
        build/asm/psxsdk/libgpu/p10.o(.text);
        build/asm/47EF8.o(.text);
        build/asm/psxsdk/libcard/patch_card.o(.text);
        build/asm/psxsdk/libcard/patch_card2.o(.text);
        build/asm/psxsdk/libapi/a36.o(.text);
        build/asm/psxsdk/libapi/a37.o(.text);
        build/asm/psxsdk/libapi/open.o(.text);
        build/asm/psxsdk/libapi/lseek.o(.text);
        build/asm/psxsdk/libapi/read.o(.text);
        build/asm/psxsdk/libapi/write.o(.text);
        build/asm/psxsdk/libapi/close.o(.text);
        build/asm/psxsdk/libapi/nextFile.o(.text);
        build/asm/psxsdk/libapi/erase.o(.text);
        build/asm/psxsdk/libapi/changeClearPad.o(.text);
        build/asm/49EAC.o(.text);
        . = ALIGN(., 4);
        main_TEXT_END = .;
        main_TEXT_SIZE = ABSOLUTE(main_TEXT_END - main_TEXT_START);
        main_DATA_START = .;
        _800_rodata = .;
        build/asm/data/800.rodata.o(.data);
        _28DC = .;
        build/asm/28DC.o(.data);
        mainLoop = .;
        build/src/mainLoop.o(.data);
        initGame = .;
        build/src/initGame.o(.data);
        boot = .;
        build/src/boot.o(.data);
        _12D24 = .;
        build/asm/12D24.o(.data);
        psxsdk_libspu_spu = .;
        build/asm/psxsdk/libspu/spu.o(.data);
        psxsdk_libspu_s_ini = .;
        build/asm/psxsdk/libspu/s_ini.o(.data);
        psxsdk_libspu_s_dcb = .;
        build/asm/psxsdk/libspu/s_dcb.o(.data);
        psxsdk_libsn_snmain = .;
        build/asm/psxsdk/libsn/snmain.o(.data);
        psxsdk_libcd_bios = .;
        build/asm/psxsdk/libcd/bios.o(.data);
        psxsdk_libgs_gsInitGraph = .;
        build/asm/psxsdk/libgs/gsInitGraph.o(.data);
        psxsdk_libgs_gsSetDrawBuffOffset = .;
        build/asm/psxsdk/libgs/gsSetDrawBuffOffset.o(.data);
        psxsdk_libgs_gsSetDrawBuffClip = .;
        build/asm/psxsdk/libgs/gsSetDrawBuffClip.o(.data);
        psxsdk_libgs_gsInit3D = .;
        build/asm/psxsdk/libgs/gsInit3D.o(.data);
        psxsdk_libgpu_p09 = .;
        build/asm/psxsdk/libgpu/p09.o(.data);
        psxsdk_libgpu_p10 = .;
        build/asm/psxsdk/libgpu/p10.o(.data);
        _47EE0_rodata = .;
        build/asm/data/47EE0.rodata.o(.data);
        _47EF8 = .;
        build/asm/47EF8.o(.data);
        psxsdk_libcard_patch_card = .;
        build/asm/psxsdk/libcard/patch_card.o(.data);
        pxsdk_libcard_patch_card2_rodata = .;
        build/asm/data/pxsdk/libcard/patch_card2.rodata.o(.data);
        psxsdk_libcard_patch_card2 = .;
        build/asm/psxsdk/libcard/patch_card2.o(.data);
        psxsdk_libapi_a36 = .;
        build/asm/psxsdk/libapi/a36.o(.data);
        psxsdk_libapi_a37 = .;
        build/asm/psxsdk/libapi/a37.o(.data);
        psxsdk_libapi_open = .;
        build/asm/psxsdk/libapi/open.o(.data);
        psxsdk_libapi_lseek = .;
        build/asm/psxsdk/libapi/lseek.o(.data);
        psxsdk_libapi_read = .;
        build/asm/psxsdk/libapi/read.o(.data);
        psxsdk_libapi_write = .;
        build/asm/psxsdk/libapi/write.o(.data);
        psxsdk_libapi_close = .;
        build/asm/psxsdk/libapi/close.o(.data);
        psxsdk_libapi_nextFile = .;
        build/asm/psxsdk/libapi/nextFile.o(.data);
        psxsdk_libapi_erase = .;
        build/asm/psxsdk/libapi/erase.o(.data);
        psxsdk_libapi_changeClearPad = .;
        build/asm/psxsdk/libapi/changeClearPad.o(.data);
        _49EAC = .;
        build/asm/49EAC.o(.data);
        _4A74C_data = .;
        build/asm/data/4A74C.data.o(.data);
        _6B990_data = .;
        build/asm/data/6B990.data.o(.data);
        _6BB28_data = .;
        build/asm/data/6BB28.data.o(.data);
        . = ALIGN(., 4);
        main_DATA_END = .;
        main_DATA_SIZE = ABSOLUTE(main_DATA_END - main_DATA_START);
        main_BSS_START = .;
        build/asm/data/800.rodata.o(.bss);
        build/asm/28DC.o(.bss);
        build/src/mainLoop.o(.bss);
        build/src/initGame.o(.bss);
        build/src/boot.o(.bss);
        build/asm/12D24.o(.bss);
        build/asm/psxsdk/libspu/spu.o(.bss);
        build/asm/psxsdk/libspu/s_ini.o(.bss);
        build/asm/psxsdk/libspu/s_dcb.o(.bss);
        build/asm/psxsdk/libsn/snmain.o(.bss);
        build/asm/psxsdk/libcd/bios.o(.bss);
        build/asm/psxsdk/libgs/gsInitGraph.o(.bss);
        build/asm/psxsdk/libgs/gsSetDrawBuffOffset.o(.bss);
        build/asm/psxsdk/libgs/gsSetDrawBuffClip.o(.bss);
        build/asm/psxsdk/libgs/gsInit3D.o(.bss);
        build/asm/psxsdk/libgpu/p09.o(.bss);
        build/asm/psxsdk/libgpu/p10.o(.bss);
        build/asm/data/47EE0.rodata.o(.bss);
        build/asm/47EF8.o(.bss);
        build/asm/psxsdk/libcard/patch_card.o(.bss);
        build/asm/data/pxsdk/libcard/patch_card2.rodata.o(.bss);
        build/asm/psxsdk/libcard/patch_card2.o(.bss);
        build/asm/psxsdk/libapi/a36.o(.bss);
        build/asm/psxsdk/libapi/a37.o(.bss);
        build/asm/psxsdk/libapi/open.o(.bss);
        build/asm/psxsdk/libapi/lseek.o(.bss);
        build/asm/psxsdk/libapi/read.o(.bss);
        build/asm/psxsdk/libapi/write.o(.bss);
        build/asm/psxsdk/libapi/close.o(.bss);
        build/asm/psxsdk/libapi/nextFile.o(.bss);
        build/asm/psxsdk/libapi/erase.o(.bss);
        build/asm/psxsdk/libapi/changeClearPad.o(.bss);
        build/asm/49EAC.o(.bss);
        . = ALIGN(., 4);
        main_BSS_END = .;
        main_BSS_SIZE = ABSOLUTE(main_BSS_END - main_BSS_START);
    }
    __romPos += SIZEOF(.main);
    __romPos = ALIGN(__romPos, 4);
    . = ALIGN(., 4);
    main_ROM_END = __romPos;
    main_VRAM_END = .;

    /DISCARD/ :
    {
        *(*);
    }
}
